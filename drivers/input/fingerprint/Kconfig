## drivers/input/fingerprint/Kconfig
```kconfig
config GOODIX_GF5228
	tristate "FingerPrint sensor"
	depends on SPI_MASTER
	help
		add for support FP Sensor.
```

## drivers/input/side_fingerprint/Kconfig
```kconfig
config GOODIX_GF3206
	tristate "FingerPrint sensor"
	depends on SPI_MASTER
	help
		add for support FP Sensor.
```

## drivers/misc/fingerprint/Kconfig
```kconfig
#
#Fingerprint
#
menu "Finger support"
	depends on !UML

config FINGERPRINT
	tristate "Qcom Fingerprint"
	default n
	---help---
	Fingerprint mtk driver enable/disable in the kernel.
	Say Y here if you want to use qcom fingerprint driver,
	fingerprint driver will support fingerprint function in REE,
	it supports chipone device.

if FINGERPRINT

config CHIPONE_FINGERPRINT
	tristate "Chipone Fingerprint"
	default n
	---help---
	Chipone Fingerprint driver

endif

endmenu
```

## drivers/sensors/Kconfig
```kconfig
config SENSORS_SSC
	bool "Enable Sensors Driver Support for SSC"
	help
	  Add support for sensors SSC driver.
	  This driver is used for exercising sensors use case,
	  time syncing with ADSP clock.

config INPUT_CM3323E
	tristate "CM3323E RGB color sensor"
	depends on I2C
	help
	  Say Y here to enable the CM3323E RGB Color Sensor.

config INPUT_TCS3400
	tristate "AMS TCS3400 RGB color sensor"
	depends on I2C
	help
	  Say Y here to enable the TCS3400 RGB Color Sensor.	
```
